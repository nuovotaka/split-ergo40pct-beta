## boards/arm/akdk_bt1/akdk_bt1_defconfig
```kconfig
CONFIG_SOC_SERIES_NRF52X=y
CONFIG_SOC_NRF52840_QIAA=y
CONFIG_BOARD_AKDK_BT1=y

# Enable MPU
CONFIG_ARM_MPU=y

CONFIG_PINCTRL=y

# enable GPIO
CONFIG_GPIO=y

CONFIG_USE_DT_CODE_PARTITION=y
CONFIG_BUILD_OUTPUT_UF2=y

CONFIG_MPU_ALLOW_FLASH_WRITE=y
CONFIG_NVS=y
CONFIG_SETTINGS_NVS=y
CONFIG_FLASH=y
CONFIG_FLASH_PAGE_LAYOUT=y
CONFIG_FLASH_MAP=y

CONFIG_ZMK_RGB_UNDERGLOW=n
CONFIG_WS2812_STRIP=n

#CONFIG_ZMK_RGB_UNDERGLOW_HUE_START=160
#CONFIG_ZMK_RGB_UNDERGLOW_EFF_START=3


CONFIG_ZMK_USB=y
CONFIG_ZMK_BLE=y

CONFIG_HEAP_MEM_POOL_SIZE=4096
#CONFIG_ZMK=y
CONFIG_INPUT=y
CONFIG_PAW32XX_SCROLL_TICK=10
CONFIG_PAW32XX_SENSOR_ROTATION_90=y
```

## config/west.yml
```yaml
manifest:
  remotes:
    - name: nuovotaka
      url-base: https://github.com/nuovotaka
    - name: zmkfirmware
      url-base: https://github.com/zmkfirmware
  projects:
    - name: zmk
      remote: zmkfirmware
      revision: v0.3.0
      import: app/west.yml
    - name: zmk-pointing-acceleration-alpha
      remote: nuovotaka
      revision: main
    - name: zmk-driver-paw3222-alpha
      remote: nuovotaka
      revision: main
  self:
    path: config
```
